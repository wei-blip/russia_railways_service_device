## app/cmake-build-debug/Kconfig/Kconfig.shield
```kconfig
osource "/home/rts/tmp/projects/beacon_project_rzd/service_device/app/../modules/rts-zephyr/boards/shields/*/Kconfig.shield"
osource "/home/rts/tmp/projects/beacon_project_rzd/service_device/app/../modules/rts-zephyr/boards/shields/*/Kconfig.shield"
```

## app/cmake-build-debug/Kconfig/Kconfig.shield.defconfig
```kconfig
osource "/home/rts/tmp/projects/beacon_project_rzd/service_device/app/../modules/rts-zephyr/boards/shields/*/Kconfig.defconfig"
osource "/home/rts/tmp/projects/beacon_project_rzd/service_device/app/../modules/rts-zephyr/boards/shields/*/Kconfig.defconfig"
```

## app/cmake-build-release/Kconfig/Kconfig.modules
```kconfig
menu "CANopenNode (/home/rts/zephyr-rts-master/modules/lib/canopennode)"
osource "$(ZEPHYR_CANOPENNODE_KCONFIG)"
config ZEPHYR_CANOPENNODE_MODULE
	bool
	default y
endmenu
menu "hal_gigadevice (/home/rts/zephyr-rts-master/modules/hal/gigadevice)"
osource "$(ZEPHYR_HAL_GIGADEVICE_KCONFIG)"
config ZEPHYR_HAL_GIGADEVICE_MODULE
	bool
	default y
endmenu
menu "hal_nordic (/home/rts/zephyr-rts-master/modules/hal/nordic)"
osource "$(ZEPHYR_HAL_NORDIC_KCONFIG)"
config ZEPHYR_HAL_NORDIC_MODULE
	bool
	default y
endmenu
menu "hal_nxp (/home/rts/zephyr-rts-master/modules/hal/nxp)"
osource "$(ZEPHYR_HAL_NXP_KCONFIG)"
config ZEPHYR_HAL_NXP_MODULE
	bool
	default y
endmenu
menu "hal_rpi_pico (/home/rts/zephyr-rts-master/modules/hal/rpi_pico)"
osource "$(ZEPHYR_HAL_RPI_PICO_KCONFIG)"
config ZEPHYR_HAL_RPI_PICO_MODULE
	bool
	default y
endmenu
menu "loramac-node (/home/rts/zephyr-rts-master/modules/lib/loramac-node)"
osource "$(ZEPHYR_LORAMAC_NODE_KCONFIG)"
config ZEPHYR_LORAMAC_NODE_MODULE
	bool
	default y
endmenu
menu "lz4 (/home/rts/zephyr-rts-master/modules/lib/lz4)"
osource "$(ZEPHYR_LZ4_KCONFIG)"
config ZEPHYR_LZ4_MODULE
	bool
	default y
endmenu
menu "mbedtls (/home/rts/zephyr-rts-master/modules/crypto/mbedtls)"
osource "$(ZEPHYR_MBEDTLS_KCONFIG)"
config ZEPHYR_MBEDTLS_MODULE
	bool
	default y
endmenu
menu "nanopb (/home/rts/zephyr-rts-master/modules/lib/nanopb)"
osource "$(ZEPHYR_NANOPB_KCONFIG)"
config ZEPHYR_NANOPB_MODULE
	bool
	default y
endmenu
menu "sof (/home/rts/zephyr-rts-master/modules/audio/sof)"
osource "/home/rts/zephyr-rts-master/modules/audio/sof/zephyr/Kconfig"
config ZEPHYR_SOF_MODULE
	bool
	default y
endmenu
menu "tflite-micro (/home/rts/zephyr-rts-master/modules/lib/tflite-micro)"
osource "$(ZEPHYR_TFLITE_MICRO_KCONFIG)"
config ZEPHYR_TFLITE_MICRO_MODULE
	bool
	default y
endmenu
menu "TraceRecorder (/home/rts/zephyr-rts-master/modules/debug/TraceRecorder)"
osource "/home/rts/zephyr-rts-master/modules/debug/TraceRecorder/kernelports/Zephyr/Kconfig"
config ZEPHYR_TRACERECORDER_MODULE
	bool
	default y
endmenu
menu "trusted-firmware-m (/home/rts/zephyr-rts-master/modules/tee/tf-m/trusted-firmware-m)"
osource "$(ZEPHYR_TRUSTED_FIRMWARE_M_KCONFIG)"
config ZEPHYR_TRUSTED_FIRMWARE_M_MODULE
	bool
	default y
endmenu
menu "zscilib (/home/rts/zephyr-rts-master/modules/lib/zscilib)"
osource "/home/rts/zephyr-rts-master/modules/lib/zscilib/Kconfig.zscilib"
config ZEPHYR_ZSCILIB_MODULE
	bool
	default y
endmenu
menu "rts-zephyr (/home/rts/tmp/projects/beacon_project_rzd/service_device/app/../modules/rts-zephyr)"
osource "/home/rts/tmp/projects/beacon_project_rzd/service_device/modules/rts-zephyr/Kconfig"
config ZEPHYR_RTS_ZEPHYR_MODULE
	bool
	default y
endmenu
```

## modules/rts-zephyr/boards/arm/rs_0015_100/Kconfig.board
```kconfig
# RS_0015_100 board configuration

config BOARD_RS_0015_100
    bool "RS.0015-100 Board"
    depends on SOC_STM32L452XX
```

## modules/rts-zephyr/boards/arm/rs_0015_100/Kconfig.defconfig
```kconfig
# RS_0015_100 board configuration

if BOARD_RS_0015_100

config BOARD
    default "RS.0015-100 Board"

config SPI_STM32_INTERRUPT
    default y
    depends on SPI

# config SPI_STM32_DMA
#     default y
#     depends on SPI

choice STM32_LPTIM_CLOCK
    default STM32_LPTIM_CLOCK_LSI
endchoice

choice COUNTER_RTC_STM32_CLOCK_SRC
    default COUNTER_RTC_STM32_CLOCK_LSI
endchoice

endif # BOARD_RS_0015_100
```

## modules/rts-zephyr/boards/arm/rs_0015_100/rs_0015_100_defconfig
```kconfig
CONFIG_SOC_SERIES_STM32L4X=y
CONFIG_SOC_STM32L452XX=y

# enable uart driver
CONFIG_SERIAL=y

# Enable MPU
CONFIG_ARM_MPU=y

# Enable FPU
CONFIG_FPU=y

# Enable HW stack protection
CONFIG_HW_STACK_PROTECTION=y

# enable pinmux
CONFIG_PINMUX=y

# enable GPIO
CONFIG_GPIO=y

# Enable Clocks
CONFIG_CLOCK_CONTROL=y
CONFIG_STM32_LPTIM_CLOCK_LSI=y

# console
CONFIG_CONSOLE=y
CONFIG_UART_CONSOLE=y
```

## modules/rts-zephyr/boards/arm/rs_0022_100/Kconfig.board
```kconfig
# RS_0022_100 board configuration

config BOARD_RS_0022_100
	bool "RS.0022-100 Board"
	depends on SOC_STM32L452XX
```

## modules/rts-zephyr/boards/arm/rs_0022_100/Kconfig.defconfig
```kconfig
# RS_0022_100 board configuration

if BOARD_RS_0022_100

config BOARD
	default "RS.0022-100 Board"

config SPI_STM32_INTERRUPT
 	default y
 	depends on SPI

endif # BOARD_RS_0022_100
```

## modules/rts-zephyr/boards/arm/rs_0025_100/Kconfig
```kconfig
config BOARD_ENABLE_DCDC
	bool "Enable DCDC mode"
	select SOC_DCDC_NRF52X
	default y
	depends on BOARD_RS_0025_100
```

## modules/rts-zephyr/boards/arm/rs_0025_100/Kconfig.board
```kconfig
config BOARD_RS_0025_100
	bool "RS.0025-100 Board"
	depends on SOC_NRF52832_QFAA
```

## modules/rts-zephyr/boards/arm/rs_0025_100/Kconfig.defconfig
```kconfig
# RS_0025_100 board configuration

if BOARD_RS_0025_100

config BOARD
	default "RS.0025-100 Board"

config BT_CTLR
	default BT

config SPI
	default y
	depends on (IEEE802154 || DW1000)

config IEEE802154_DW1000
	default y
	depends on IEEE802154

config NET_CONFIG_IEEE802154_DEV_NAME
	default "DW1000"

endif # BOARD_RS_0025_100
```

## modules/rts-zephyr/drivers/Kconfig
```kconfig
menu "Device Drivers"

rsource "uwb/Kconfig"
rsource "led_strip/Kconfig"
rsource "eeprom/Kconfig"

menuconfig COMP_STM32
    bool "STM32 MCU comparator driver"
    select USE_STM32_LL_COMP
    depends on SOC_FAMILY_STM32
    help
      Enable comparator support on the STM32 family of processors.

endmenu
```

## modules/rts-zephyr/drivers/eeprom/Kconfig
```kconfig
# EEPROM driver configuration options

# Copyright (c) 2019 Vestas Wind Systems A/S
# SPDX-License-Identifier: Apache-2.0

menuconfig EEPROM
	bool "EEPROM hardware support"
	help
	  Enable support for EEPROM hardware.

if EEPROM

module = EEPROM
module-str = eeprom
source "subsys/logging/Kconfig.template.log_config"

config EEPROM_ST25DV
	bool "ST25DV NFC as EEPROM"
	depends on I2C
	help
	  Enable support for ST25DV NFC tag for use as an EEPROM.

endif # EEPROM
```

## modules/rts-zephyr/drivers/uwb/Kconfig
```kconfig
menu "UWB"

menuconfig DW1000
	bool "DW1000 Tranceiver"
	help
		Include DW1000 Tranceiver drivers in config

if DW1000

config DW1000_INIT_PRIO
    int "Driver initialization priority"
    default 80
    help
        Set the initialization priority number. Do not mess with it unless
        you know what you are doing. Beware DW1000 requires gpio and spi to
        be ready first (and sometime gpio should be the very first as spi
        might need it too). And of course it has to start before the net stack.

menu "Startup flags"

config DW1000_STARTUP_LOADUCODE
    bool "Load uCode"
    default n
    help
        this can be called on power up or after wake up to load ucode
config DW1000_STARTUP_DW_WAKE_UP
    bool "DW WakeUp"
    default n
    help
        init after wake up - will not load ucode / ucode will not run
config DW1000_STARTUP_DW_WUP_NO_UCODE
    bool "DW WakeUp - no uCode"
    default n
    help
        init after wake up - ucode has not already been loaded / ucode is not used
config DW1000_STARTUP_DW_WUP_RD_OTPREV
    bool "DW WakeUp - read OTP Rev"
    default n
    help
       init after wakeup - read OTP rev after wake up
config DW1000_STARTUP_READ_OTP_PID
    bool "Read OTP Part ID"
    default n
    help
       read part ID from OTP
config DW1000_STARTUP_READ_OTP_LID
    bool "Read OTP Lot ID"
    default n
    help
       read lot ID from OTP
config DW1000_STARTUP_READ_OTP_BAT
    bool "Read OTP Battery"
    default n
    help
       read ref voltage from OTP
config DW1000_STARTUP_READ_OTP_TMP
    bool "Read OTP Temperature"
    default n
    help
       read ref temperature from OTP
endmenu

menu "Default PHY configuration"

config DW1000_CHANNEL_NO
    int "RF channel number"
    default 5
    range 1 7
    help
        Channel number {1, 2, 3, 4, 5, 7}.

choice DW1000_PRF
    bool "PRF"
    default DW1000_PRF_64M
    help
        Pulse Repetition Frequency.
config DW1000_PRF_16M
    bool "16 MHz"
config DW1000_PRF_64M
    bool "64 MHz"
endchoice

choice DW1000_PLEN
    bool "Preamble length"
    default DW1000_PLEN_128
    help
        Preamble length. Used in TX only.
config DW1000_PLEN_4096
    bool "4096"
    help
        Standard preamble length 4096 symbols
config DW1000_PLEN_2048
    bool "2048"
    help
        Non-standard preamble length 2048 symbols
config DW1000_PLEN_1536
    bool "1536"
    help
        Non-standard preamble length 1536 symbols
config DW1000_PLEN_1024
    bool "1024"
    help
        Standard preamble length 1024 symbols
config DW1000_PLEN_512
    bool "512"
    help
        Non-standard preamble length 512 symbols
config DW1000_PLEN_256
    bool "256"
    help
        Non-standard preamble length 256 symbols
config DW1000_PLEN_128
    bool "128"
    help
        Non-standard preamble length 128 symbols
config DW1000_PLEN_64
    bool "64"
    help
        Standard preamble length 64 symbols
endchoice

choice DW1000_RX_PAC
    bool "RX PAC"
    default DW1000_RX_PAC8
    help
        Preamble acquisition chunk size. Used in RX only.
config DW1000_RX_PAC8
    bool "8"
    help
        PAC  8 (recommended for RX of preamble length  128 and below).
config DW1000_RX_PAC16
    bool "16"
    help
        PAC 16 (recommended for RX of preamble length  256).
config DW1000_RX_PAC32
    bool "32"
    help
        PAC 32 (recommended for RX of preamble length  512).
config DW1000_RX_PAC64
    bool "64"
    help
        PAC 64 (recommended for RX of preamble length 1024 and up).
endchoice

config DW1000_TX_PREAMBLE_CODE
    int "TX preamble code"
    default 9
    range 1 25
    help
        TX preamble code. Used in TX only.

config DW1000_RX_PREAMBLE_CODE
    int "RX preamble code"
    default 9
    range 1 25
    help
        RX preamble code. Used in RX only.

choice DW1000_SFD
    bool "SFD"
    default DW1000_SFD_NON_STD
    help
        Use standard or non-standard SFD for better performance.
config DW1000_SFD_STD
    bool "standard"
    help
        Use standard SFD.
config DW1000_SFD_NON_STD
    bool "non-standard"
    help
        Use non-standard SFD for better performance.
endchoice

choice DW1000_BR
    bool "Baudrate"
    default DW1000_BR_6M8
    help
        Data Rate
config DW1000_BR_110K
    bool "110 kbps"
    help
        UWB bit rate 110 kbits/s
config DW1000_BR_850K
    bool "850 kbps"
    help
        UWB bit rate 850 kbits/s
config DW1000_BR_6M8
    bool "6.8 Mbps"
    help
        UWB bit rate 6.8 Mbits/s
endchoice

choice DW1000_PHR_MODE
    bool "PHY header mode."
    default DW1000_PHR_MODE_EXT
    help
        PHR mode
config DW1000_PHR_MODE_STD
    bool "standard"
    help
        standard PHR mode
config DW1000_PHR_MODE_EXT
    bool "extended"
    help
        DW proprietary extended frames PHR mode
endchoice

config DW1000_SFD_TIMEOUT
    int "SFD timeout"
    default 129
    help
        SFD timeout (preamble length + 1 + SFD length - PAC size).

endmenu

endif

endmenu
```

## modules/rts-zephyr/subsys/Kconfig
```kconfig
menu "Sub Systems and OS Services"

rsource "meshposition/Kconfig"

rsource "cobs/Kconfig"

rsource "led_utils/Kconfig"

endmenu
```

## modules/rts-zephyr/subsys/cobs/Kconfig
```kconfig
menuconfig COBS
    bool "COBS library"
    default n
    help
        Enable Consistent Overhead Byte Stuffing algorithm library.
```

## modules/rts-zephyr/subsys/led_utils/Kconfig
```kconfig
menuconfig LED_UTILS
    bool "LED strip utility library"
    default n
    help
        Enable LED utilities (HSV to RGB transform and gamma correction).

if LED_UTILS
	config LED_UTILS_USE_PRECALCULATED_GAMMA_TABLE
		bool "Use precalculated gamma table"
		default n
		help
		    Use precalculated table for gamma correction
endif # LED_UTILS
```
